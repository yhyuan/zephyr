## boards/riscv/sipeed_longan_nano/Kconfig.board
```kconfig
# SPDX-License-Identifier: Apache-2.0

config BOARD_LONGAN_NANO
	bool "HiFive1 target"
	depends on SOC_RISCV_GIGADEVICE_GD32VF103
```

## boards/riscv/sipeed_longan_nano/Kconfig.defconfig
```kconfig
# Sipeed longan nano Development Board Configuration

# Copyright (c) 2017, embedjournal.com
# SPDX-License-Identifier: Apache-2.0

if BOARD_SIPEED_LONGAN_NANO || BOARD_SIPEED_LONGAN_NANO_LITE

config BOARD
	default "sipeed_longan_nano" if BOARD_SIPEED_LONGAN_NANO
	default "sipeed_longan_nano_lite" if BOARD_SIPEED_LONGAN_NANO_LITE

if UART_CONSOLE

config UART_0
	default y

endif # UART_CONSOLE

endif # BOARD_SIPEED_LONGAN_NANO
```

## boards/riscv/sipeed_longan_nano/sipeed_longan_nano_defconfig
```kconfig
# SPDX-License-Identifier: Apache-2.0

CONFIG_RISCV=y
CONFIG_SOC_SERIES_RISCV_GIGADEVICE_GD32VF103=y
CONFIG_SOC_RISCV_GIGADEVICE_GD32VF103=y
CONFIG_BOARD_LONGAN_NANO=y
CONFIG_CONSOLE=n
CONFIG_PRINTK=n
CONFIG_SERIAL=n
CONFIG_UART_SIFIVE=n
CONFIG_UART_SIFIVE_PORT_0=n
CONFIG_UART_CONSOLE=n
CONFIG_PLIC=n
CONFIG_PINMUX=n
CONFIG_PINMUX_SIFIVE=n
CONFIG_RISCV_MACHINE_TIMER=n
CONFIG_GPIO=n
CONFIG_GPIO_SIFIVE=n
CONFIG_SPI=n
CONFIG_SPI_SIFIVE=n
CONFIG_BOOT_BANNER=n
CONFIG_MINIMAL_LIBC=y
```

## drivers/interrupt_controller/Kconfig.gd32
```kconfig
# GD32 EXTI configuration

# Copyright (c) 2016 Open-RnD Sp. z o.o.
# SPDX-License-Identifier: Apache-2.0

if SOC_SERIES_RISCV_GIGADEVICE_GD32VF103

config EXTI_GD32
	bool "External Interrupt/Event Controller (EXTI) Driver for GD32 family of MCUs"
	default y if SOC_SERIES_RISCV_GIGADEVICE_GD32VF103
	help
	  Enable EXTI driver for GD32 line of MCUs

config EXTI_GD32_EXTI1_0_IRQ_PRI
	int "EXTI1:0 IRQ priority"
	depends on EXTI_GD32
	default 0
	help
	  IRQ priority of EXTI1:0 interrupt

config EXTI_GD32_EXTI3_2_IRQ_PRI
	int "EXTI3:2 IRQ priority"
	depends on EXTI_GD32
	default 0
	help
	  IRQ priority of EXTI3:2 interrupt

config EXTI_GD32_EXTI15_4_IRQ_PRI
	int "EXTI15:4 IRQ priority"
	depends on EXTI_GD32
	default 0
	help
	  IRQ priority of EXTI15:4 interrupt


endif # SOC_FAMILY_GD32
```
